/dts-v1/;
#include "promicro_nrf52840_nrf52840_common.dts"
#include "promicro_nrf52840_flash_uf2.dtsi"

/ {
	model = "Pro Micro nRF52840 UF2";
	compatible = "others,promicro-nrf52840-uf2";

	chosen {
		zephyr,console = &cdc_acm_uart0;
		zephyr,shell-uart = &cdc_acm_uart0;
		zephyr,uart-mcumgr = &cdc_acm_uart0;
		zephyr,bt-mon-uart = &cdc_acm_uart0;
		zephyr,bt-c2h-uart = &cdc_acm_uart0;
	};
};
