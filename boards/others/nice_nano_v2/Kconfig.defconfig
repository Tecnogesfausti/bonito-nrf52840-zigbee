## boards/others/nice_nano_v2/Kconfig.defconfig
```kconfig
# SPDX-License-Identifier: Apache-2.0

if BOARD_NICE_NANO_V2

config BT_CTLR
	default BT

endif
```

## boards/others/nice_nano_v2/board.yml
```yaml
board:
  name: nice_nano_v2
  full_name: nice!nano v2
  vendor: others
  socs:
    - name: nrf52840
      variants:
        - name: uf2
```

## boards/others/promicro_nrf52840/promicro_nrf52840_nrf52840_defconfig
```kconfig
# SPDX-License-Identifier: Apache-2.0

CONFIG_ARM_MPU=y
CONFIG_HW_STACK_PROTECTION=y
CONFIG_GPIO=y
CONFIG_USB_DEVICE_REMOTE_WAKEUP=n
```
